#include "reg51.h"			 //此文件中定义了单片机的一些特殊功能寄存器
#include<intrins.h>

typedef unsigned int u16;	  //对数据类型进行声明定义
typedef unsigned char u8;

sbit SRCLK=P3^6;
sbit RCLK=P3^5;
sbit SER=P3^4;

u8 ledduan[]={0x00,0x00,0x3e,0x41,0x41,0x41,0x3e,0x00};
u8 ledwei[][8]={{0x70,0x88,0x84,0x42,0x42,0x84,0x88,0x70},
				{0x70,0xF8,0xCC,0x46,0x46,0xCC,0xF8,0x70},
				{0x70,0xF8,0xFC,0x6E,0x6E,0xFC,0xF8,0x70},
				{0x70,0xF8,0xFC,0x7E,0x7E,0xFC,0xF8,0x70},
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				{0x08,0x18,0x28,0x48,0xFF,0x08,0x08,0x00}};

void delay(u16 i)
{
	while(i--);	
}

void Hc595SendByte(u8 dat)
{
	u8 a;
	SRCLK=0;
	RCLK=0;
	for(a=0;a<8;a++)
	{
		SER=dat>>7;
		dat<<=1;

		SRCLK=1;
		_nop_();
		_nop_();
		SRCLK=0;	
	}

	RCLK=1;
	_nop_();
	_nop_();
	RCLK=0;
}

void main()
{			
	u8 i,j;
	while(1)
	{
		for(j=0;j<11;j++)
		{
		P0=0x7f;
		for(i=0;i<8;i++)
		{
			P0=ledwei[j][i];		  //位选
			Hc595SendByte(ledduan[i]);	//发送段选数据
			delay(100);		   //延时
			Hc595SendByte(0x00);  //消隐
		} delay(50000);
		  delay(50000);delay(50000);
		}	
	}		
}
